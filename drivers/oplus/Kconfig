## drivers/oplus/Kconfig
```kconfig
# SPDX-License-Identifier: GPL-2.0-only
# Copyright (C) 2018-2020 Oplus. All rights reserved.

config OPLUS_PORT
	bool "oplus port"
	default y if E404_OPLUS
	help
	  This will allow all OPLUS Feature to be built for ColorOS/OxygenOS port compatibility.

config OPLUS_OPROJECT
	bool "oplus project"
	default y if OPLUS_PORT || E404_OPLUS
	help
	  Define this config to define oplus project ID and board revision.
	  
config OPLUS_NANDSWAP
	bool "nandswap feature"
	default y if OPLUS_PORT || E404_OPLUS
	help
	  Nandswap (RAM expansion) feature for OPlus.

config OPLUS_NANDSWAP_DEBUG
	bool "nandswap debug"
	depends on F2FS_FS
	default n
	help
	  Nandswap debug logging.

config OPLUS_NWPOWER
	bool "OPLUS NWPOWER"
	default y if OPLUS_PORT || E404_OPLUS
	help
	  Network power and socket hooks for OPlus.

config OPLUS_SUBSYS_SLEEP_MONITOR
	bool "monitor Qualcomm subsystem sleep"
	default y if OPLUS_PORT || E404_OPLUS
	help
	  This selects to get sleep info for Qualcomm subsystem.

config OPLUS_WAKELOCK_PROFILER
	bool "config oplus wakelock profiler"
	default y if OPLUS_PORT || E404_OPLUS
	help
	  Select this config to enable oplus wakelock profiler.

config OPLUS_POWERINFO_STANDBY_DEBUG
	bool "powerinfo standby config"
	default n
	help
	  Select this config to enable powerinfo standby debug.

config OPLUS_POWERINFO_RPMH
	bool "powerinfo rpmh config"
	default n
	help
	  Select this config to enable powerinfo rpmh,
	  currently broken, do not enable this.

config OPLUS_POWERINFO_FTM
	bool "powerinfo ftm config"
	default n
	help
	  Select this config to enable powerinfo ftm.

config OPLUS_STUB_NODES
	bool "oplus missing nodes stubs"
	depends on OPLUS_PORT || E404_OPLUS
	default y
	help
	  Select this to enable dummy stubs for missing oplus procfs and sysfs nodes.
```
